/ {
	amba_pl: amba_pl {
		ranges;
		compatible = "simple-bus";
		#address-cells = <2>;
		#size-cells = <2>;
		firmware-name = "led.pdi";
		MyLEDIP_0: MyLEDIP@a4000000 {
			compatible = "xlnx,MyLEDIP-1.0";
			status = "okay";
			clock-names = "s00_axi_aclk";
			xlnx,ip-name = "MyLEDIP";
			xlnx,edk-iptype = "PERIPHERAL";
			reg = <0x0 0xa4000000 0x0 0x1000>;
			clocks = <&versal_clk 66>;
			xlnx,name = "MyLEDIP_0";
		};
	};
};
