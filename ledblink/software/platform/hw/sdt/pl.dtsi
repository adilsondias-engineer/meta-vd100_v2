/ {
	amba_pl: amba_pl {
		ranges;
		compatible = "simple-bus";
		#address-cells = <2>;
		#size-cells = <2>;
		firmware-name = "led.pdi";
		MyLEDIP_0: MyLEDIP@20100000000 {
			xlnx,s00-axi-data-width = <32>;
			compatible = "xlnx,MyLEDIP-1.0";
			status = "okay";
			clock-names = "s00_axi_aclk";
			xlnx,s00-axi-addr-width = <4>;
			xlnx,ip-name = "MyLEDIP";
			xlnx,edk-iptype = "PERIPHERAL";
			reg = <0x00000201 0x00000000 0x0 0x10000>;
			clocks = <&versal_clk 65>;
			xlnx,name = "MyLEDIP_0";
		};
	};
};
