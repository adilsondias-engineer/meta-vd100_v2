## yocto/meta-vd100_v2/conf/machine/include/versal-generic-xcve2302/versal-generic-xcve2302-microblaze-pmc-features.conf
```bitbake
MACHINE_FEATURES = "cframe cfupmc common csudma emacps gpiops iomodule ipipsu qspipsu sdps sysmonpsv trngpsv ttcps uartlite uartpsv usbpsu zdma"
```
