/dts-v1/;
/plugin/;
&fpga {
	firmware-name = "led.pdi";
};

&amba {
	MyLEDIP_0: MyLEDIP@a4000000 {
		compatible = "xlnx,MyLEDIP-1.0";
		clock-names = "s00_axi_aclk";
		xlnx,ip-name = "MyLEDIP";
		xlnx,edk-iptype = "PERIPHERAL";
		reg = <0x0 0xa4000000 0x0 0x1000>;
		clocks = <&versal_clk 66>;
		xlnx,name = "MyLEDIP_0";
	};
};
